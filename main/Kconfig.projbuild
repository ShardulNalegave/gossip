## main/Kconfig.projbuild
```kconfig
menu "Gossip Configuration"

    config GOSSIP_WIFI_SSID
        string "WiFi SSID"
        default "myssid"
        help
            SSID (network name) for Gossip to connect to.

    config GOSSIP_WIFI_PASSWORD
        string "WiFi Password"
        default "mypassword"
        help
            WiFi password (WPA or WPA2) for Gossip to use.

    config GOSSIP_WIFI_MAXIMUM_RETRY
        int "Maximum retry"
        default 5
        help
            Set the Maximum retry to avoid station reconnecting to the AP.

endmenu
```
